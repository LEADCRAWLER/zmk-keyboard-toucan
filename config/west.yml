## config/west.yml
```yaml
manifest:
  defaults:
    revision: v0.3
  remotes:
    - name: zmkfirmware
      url-base: https://github.com/zmkfirmware
    - name: petejohanson
      url-base: https://github.com/petejohanson/
    - name: alee0729
      url-base: https://github.com/alee0729
    - name: caksoylar
      url-base: https://github.com/caksoylar
  projects:
    - name: zmk
      remote: zmkfirmware
      import: app/west.yml
    - name: cirque-input-module
      remote: alee0729
      revision: cdac7282  # 2026-03-21, PM-Features (PR #1-#4)
    - name: zmk-rgbled-widget
      remote: caksoylar
      revision: a3510c9d
  self:
    path: config
```
